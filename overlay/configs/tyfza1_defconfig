## overlay/configs/tyfza1_defconfig
```kconfig
CONFIG_ARM=y
CONFIG_LTO=y
CONFIG_LZMA_SIZE_OPTIMIZATION=y
# CONFIG_SYS_LONGHELP is not set
CONFIG_TARGET_TYFZA1=y
CONFIG_COUNTER_FREQUENCY=25000000
CONFIG_TEXT_BASE=0x04000000
CONFIG_POSITION_INDEPENDENT=y
CONFIG_SYS_MALLOC_LEN=0x2000000
CONFIG_SYS_MALLOC_F_LEN=0x4000
CONFIG_NR_DRAM_BANKS=2
CONFIG_HAS_CUSTOM_SYS_INIT_SP_ADDR=y
CONFIG_CUSTOM_SYS_INIT_SP_ADDR=0x01000000
CONFIG_ENV_SIZE=0x40000
CONFIG_ENV_OFFSET=0x280000
CONFIG_ENV_OFFSET_REDUND=0x2c0000
CONFIG_ENV_RANGE=0x40000
CONFIG_ENV_IS_IN_NAND=y
CONFIG_ENV_REDUNDANT=y
CONFIG_ENV_OVERWRITE=y
CONFIG_ENV_SOURCE_FILE="tyfza1"
CONFIG_DEFAULT_DEVICE_TREE="rtl9617c-tyfza1"
# CONFIG_OF_UPSTREAM is not set
CONFIG_SYS_LOAD_ADDR=0x10000000
CONFIG_SYS_BOOTM_LEN=0x8000000
CONFIG_IDENT_STRING=" TYFZA1"
CONFIG_SYS_PROMPT="TYFZA1# "
CONFIG_SYS_CBSIZE=1024
CONFIG_SYS_PBSIZE=1056
CONFIG_HUSH_PARSER=y
CONFIG_BOOTDELAY=3
CONFIG_FIT=y
CONFIG_FIT_VERBOSE=y
CONFIG_FIT_FULL_CHECK=y
CONFIG_SUPPORT_RAW_INITRD=y
CONFIG_BOOTSTD=n
CONFIG_CMD_BOOTI=y
CONFIG_CMD_BOOTMENU=y
CONFIG_CMD_GPIO=y
CONFIG_CMD_SMC=y
CONFIG_CMD_CACHE=y
CONFIG_CMD_HASH=y
CONFIG_CMD_MTDPARTS=y
CONFIG_CMD_NAND=y
CONFIG_CMD_MTD=y
CONFIG_CMD_UBI=y
CONFIG_CMD_UBI_RENAME=y
# CONFIG_CMD_UBIFS is not set
# CONFIG_CMD_ELF is not set
# CONFIG_CMD_LOADS is not set
# CONFIG_CMD_UNLZ4 is not set
# CONFIG_CMD_UNZIP is not set
CONFIG_CMD_HTTPD=y
CONFIG_HTTPD_DHCP_SERVER=y
CONFIG_CMD_DHCP=y
CONFIG_CMD_PING=y
CONFIG_CMD_TFTPBOOT=y
CONFIG_CMD_SAVEENV=y
CONFIG_CMD_SETEXPR=y
CONFIG_DM_GPIO=y
CONFIG_DM_SERIAL=y
CONFIG_CORTINA_UART=y
CONFIG_ARM_SMCCC=y
CONFIG_ARM_PSCI_FW=y
CONFIG_RSA=y
CONFIG_RSA_VERIFY_WITH_PKEY=y
CONFIG_RSASSA_PSS=y
CONFIG_MTD=y
CONFIG_DM_MTD=y
CONFIG_MTD_RAW_NAND=y
CONFIG_SYS_NAND_SELF_INIT=y
CONFIG_SYS_MAX_NAND_DEVICE=1
CONFIG_MTD_UBI=y
CONFIG_MTD_UBI_FASTMAP=y
CONFIG_MTDIDS_DEFAULT="nand0=nand0"
CONFIG_MTDPARTS_DEFAULT="mtdparts=nand0:2m(boot),512k(reserved),256k(env),256k(env2),256k(static_conf),251648k(ubi_device),-(tail)"
CONFIG_PHYLIB=y
# CONFIG_PHY_REALTEK is not set
CONFIG_DM_ETH=y
CONFIG_NET_LWIP=y
CONFIG_LWIP_TCP_WND=2920
CONFIG_NET_RANDOM_ETHADDR=y
CONFIG_SYS_RX_ETH_BUFFER=8
CONFIG_LED=y
CONFIG_LED_GPIO=y
CONFIG_BUTTON=y
CONFIG_BUTTON_GPIO=y
# CONFIG_MMC is not set
# CONFIG_EFI_LOADER is not set
# CONFIG_USB is not set
```

## tests/sandbox_cert_defconfig
```kconfig
CONFIG_SANDBOX=y
CONFIG_SANDBOX64=y
CONFIG_SANDBOX_RAM_SIZE_MB=512
CONFIG_HUSH_PARSER=y
CONFIG_PCI=y
CONFIG_TEXT_BASE=0
CONFIG_SYS_MALLOC_LEN=0x2000000
CONFIG_NR_DRAM_BANKS=1
CONFIG_ENV_SIZE=0x2000
CONFIG_SYS_LOAD_ADDR=0x1000000
CONFIG_DEFAULT_DEVICE_TREE="sandbox-tyfza1-test"
CONFIG_SANDBOX_SERIAL=y
CONFIG_SANDBOX_TIMER=y
CONFIG_TIMER_EARLY=y
CONFIG_OF_LIVE=y
CONFIG_CROS_EC=y
CONFIG_ENV_IS_NOWHERE=y
CONFIG_RSA=y
CONFIG_RSA_VERIFY_WITH_PKEY=y
CONFIG_RSASSA_PSS=y
CONFIG_CMD_HASH=y
CONFIG_SHA256=y
CONFIG_HASH=y
# CONFIG_BOARD_INIT is not set
# CONFIG_SANDBOX_SDL is not set
# CONFIG_VIDEO is not set
# CONFIG_EFI_LOADER is not set
# CONFIG_BOOTSTD is not set
# CONFIG_NET is not set
CONFIG_FIT=y
CONFIG_FIT_FULL_CHECK=y
```
